## main/Kconfig.projbuild
```kconfig
menu "Modulino test firmware"

    config MODULINO_WIFI_SSID
        string "Wi-Fi station SSID"
        default ""
        help
            SSID used by the boot-time Wi-Fi station connection test.
            Leave empty to skip the test.

    config MODULINO_WIFI_PASSWORD
        string "Wi-Fi station password"
        default ""
        help
            Password used by the boot-time Wi-Fi station connection test.
            The firmware does not log or store this value in NVS.

    config MODULINO_WIFI_CONNECT_TIMEOUT_MS
        int "Wi-Fi connection timeout (ms)"
        range 1000 60000
        default 15000
        help
            Maximum time to wait for an IPv4 address.

    config MODULINO_HUB_ID
        string "Hub ID"
        default "hub_test001"
        help
            Hub identifier used in the MQTT LWT topic and payload.

    config MODULINO_MQTT_BROKER_URI
        string "MQTT broker URI"
        default "mqtt://172.20.10.3:1883"
        help
            Plain MQTT broker URI used by the boot-time connection test.
            Leave empty to skip the test.

    config MODULINO_MQTT_CONNECT_TIMEOUT_MS
        int "MQTT connection timeout (ms)"
        range 1000 60000
        default 10000
        help
            Maximum time to wait for MQTT_EVENT_CONNECTED.

    config MODULINO_MQTT_KEEPALIVE_SECONDS
        int "MQTT keepalive (seconds)"
        range 1 3600
        default 10
        help
            Keepalive interval sent to the broker for LWT failure detection.

    choice MODULINO_PRINTER_UART_BAUD
        prompt "Printer UART baud rate"
        default MODULINO_PRINTER_UART_BAUD_115200
        help
            Baud rate for the Ender-3 V3 SE Marlin UART connection on UART2.
            All other Printer UART settings are fixed in the test firmware.

        config MODULINO_PRINTER_UART_BAUD_9600
            bool "9600"

        config MODULINO_PRINTER_UART_BAUD_19200
            bool "19200"

        config MODULINO_PRINTER_UART_BAUD_38400
            bool "38400"

        config MODULINO_PRINTER_UART_BAUD_57600
            bool "57600"

        config MODULINO_PRINTER_UART_BAUD_115200
            bool "115200"

        config MODULINO_PRINTER_UART_BAUD_250000
            bool "250000"
    endchoice

    config MODULINO_PRINTER_UART_BAUD_RATE
        int
        default 9600 if MODULINO_PRINTER_UART_BAUD_9600
        default 19200 if MODULINO_PRINTER_UART_BAUD_19200
        default 38400 if MODULINO_PRINTER_UART_BAUD_38400
        default 57600 if MODULINO_PRINTER_UART_BAUD_57600
        default 115200 if MODULINO_PRINTER_UART_BAUD_115200
        default 250000 if MODULINO_PRINTER_UART_BAUD_250000

endmenu
```
